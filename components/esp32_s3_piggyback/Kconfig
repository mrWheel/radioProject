## components/esp32_s3_piggyback/Kconfig
```kconfig
menu "TFT LCD Display EC11"

config TFT_EC11_PIN_CS
    int "TFT CS GPIO"
    default 5

config TFT_EC11_PIN_DC
    int "TFT DC GPIO"
    default 15

config TFT_EC11_PIN_RST
    int "TFT reset GPIO"
    default 4

config TFT_EC11_PIN_BL
    int "TFT backlight GPIO"
    default 2

config TFT_EC11_PIN_SCLK
    int "TFT SCLK GPIO"
    default 12

config TFT_EC11_PIN_MOSI
    int "TFT MOSI GPIO"
    default 11

config TFT_EC11_PIN_ENC_A
    int "Encoder A GPIO"
    default 16

config TFT_EC11_PIN_ENC_B
    int "Encoder B GPIO"
    default 17

config TFT_EC11_PIN_ENC_BUTTON
    int "Encoder push GPIO"
    default 6

config TFT_EC11_PIN_AUX_BUTTON
    int "Auxiliary push GPIO"
    default 1

config TFT_EC11_SPI_CLOCK_HZ
    int "Display SPI clock (Hz)"
    default 40000000
    range 1000000 80000000

config TFT_EC11_DEFAULT_ROTATION
    int "Default rotation (0-3)"
    default 3
    range 0 3

config TFT_EC11_DEFAULT_INVERT
    bool "Enable ST7789 panel inversion"
    default n

config TFT_EC11_BGR
    bool "Use BGR color order"
    default n

config TFT_EC11_ENCODER_TRANSITIONS
    int "Quadrature transitions per logical detent"
    default 4
    range 1 4

config TFT_EC11_DEBOUNCE_MS
    int "Button debounce (ms)"
    default 30
    range 5 200

config TFT_EC11_MEDIUM_MS
    int "Medium press boundary (ms)"
    default 450
    range 100 3000

config TFT_EC11_LONG_MS
    int "Long press boundary (ms)"
    default 900
    range 200 10000

endmenu
```

## components/ftp_server/Kconfig
```kconfig
#-- SPDX-License-Identifier: GPL-3.0-or-later
#-- Copyright (C) 2026 Willem Aandewiel

menu "FTP server component"

choice FTP_SERVER_LOG_LEVEL
    prompt "FTP server log level"
    default FTP_SERVER_LOG_LEVEL_INFO

config FTP_SERVER_LOG_LEVEL_NONE
    bool "None"
config FTP_SERVER_LOG_LEVEL_ERROR
    bool "Error"
config FTP_SERVER_LOG_LEVEL_WARN
    bool "Warning"
config FTP_SERVER_LOG_LEVEL_INFO
    bool "Info"
config FTP_SERVER_LOG_LEVEL_DEBUG
    bool "Debug"
config FTP_SERVER_LOG_LEVEL_VERBOSE
    bool "Verbose"
endchoice

config FTP_SERVER_LOG_LEVEL_VALUE
    int
    default 0 if FTP_SERVER_LOG_LEVEL_NONE
    default 1 if FTP_SERVER_LOG_LEVEL_ERROR
    default 2 if FTP_SERVER_LOG_LEVEL_WARN
    default 3 if FTP_SERVER_LOG_LEVEL_INFO
    default 4 if FTP_SERVER_LOG_LEVEL_DEBUG
    default 5 if FTP_SERVER_LOG_LEVEL_VERBOSE

config FTP_SERVER_ENABLE_TEST_HOOK
    bool "Enable FTP lifecycle test hook"
    default n
    help
        Enable the XTEST RESTART command for automated lifecycle tests.
        Keep disabled in production builds.

config FTP_SERVER_MAX_CLIENTS
    int "Maximum FTP clients"
    range 1 8
    default 4
    help
        Maximum number of simultaneous FTP control sessions.

endmenu
```

## components/radio_board/Kconfig
```kconfig
menu "Radio hardware"
    config RADIO_I2S_BCLK_GPIO
        int "PCM5102A BCLK GPIO"
        default 38
    config RADIO_I2S_WS_GPIO
        int "PCM5102A LRCLK GPIO"
        default 40
    config RADIO_I2S_DOUT_GPIO
        int "PCM5102A DATA GPIO"
        default 42
    config RADIO_I2S_ENABLE_GPIO
        int "DAC enable GPIO (-1 disables)"
        range -1 48
        default -1
    config RADIO_ENCODER_REVERSED
        bool "Reverse encoder direction"
        default n
    config RADIO_SELECTION_TIMEOUT_MS
        int "Station-selection inactivity timeout (ms)"
        default 20000
    config RADIO_DEFAULT_VOLUME
        int "Default volume percent"
        range 0 100
        default 40
endmenu
```
